/dts-v1/;
/plugin/;

/ {
    compatible = "rockchip,rk3588";

    fragment@0 {
        target-path = "/";
        __overlay__ {
            pwm_fan: pwm-fan {
                compatible = "pwm-fan";
                pwms = <&pwm0 0 40000 0>; // 25 kHz => period = 1e9 / 25k = 40000 ns
                #cooling-cells = <2>;
		cooling-levels = <0 50 100 150 200 255>;
		rockchip,temp-trips = <
			50000   1
			55000   2
			60000   3
			65000   4
			70000   5
		>;
            };
        };
    };
};
